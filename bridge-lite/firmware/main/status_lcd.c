// SPDX-License-Identifier: MPL-2.0
// ST7735S 160x80 LCD on T-Dongle-S3 — SPI2, 4 text rows

#include <string.h>
#include "freertos/FreeRTOS.h"
#include "freertos/semphr.h"
#include "esp_lcd_panel_io.h"
#include "driver/spi_master.h"
#include "driver/ledc.h"
#include "driver/gpio.h"
#include "esp_log.h"
#include "bridge_lite.h"

static const char *TAG = "lcd";

static esp_lcd_panel_io_handle_t s_io;
static bool s_ok;
static SemaphoreHandle_t s_mutex;

#define LCD_SPI_HOST  SPI2_HOST
#define LCD_PIN_MOSI  3
#define LCD_PIN_CLK   5
#define LCD_PIN_CS    4
#define LCD_PIN_DC    2
#define LCD_PIN_RST   1
#define LCD_PIN_BL    38
#define LCD_WIDTH     160
#define LCD_HEIGHT    80

static const uint8_t font5x8[][5] = {
    {0x00,0x00,0x00,0x00,0x00}, // 32 space
    {0x00,0x00,0x5F,0x00,0x00}, // 33 !
    {0x00,0x07,0x00,0x07,0x00}, // 34 "
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    {0x08,0x08,0x2A,0x1C,0x08}, // 126 ~
};

#define CHAR_W  12
#define CHAR_H  20
#define COLS    (LCD_WIDTH / CHAR_W)

static uint16_t s_row_buf[LCD_WIDTH * CHAR_H];

static uint16_t rgb565(uint8_t r, uint8_t g, uint8_t b)
{
    uint16_t c = ((r >> 3) << 11) | ((g >> 2) << 5) | (b >> 3);
    return (c >> 8) | (c << 8);
}

static void st7735_send_cmd(uint8_t cmd)
{
    esp_lcd_panel_io_tx_param(s_io, cmd, NULL, 0);
}

static void st7735_send_cmd_data(uint8_t cmd, const uint8_t *data, int len)
{
    esp_lcd_panel_io_tx_param(s_io, cmd, data, len);
}

#define GAP_X   1
#define GAP_Y  26

static void st7735_set_window(int x0, int y0, int x1, int y1)
{
    int cx0 = x0 + GAP_X, cx1 = x1 + GAP_X;
    int ry0 = y0 + GAP_Y, ry1 = y1 + GAP_Y;
    uint8_t ca[] = {(uint8_t)(cx0>>8),(uint8_t)cx0,(uint8_t)(cx1>>8),(uint8_t)cx1};
    uint8_t ra[] = {(uint8_t)(ry0>>8),(uint8_t)ry0,(uint8_t)(ry1>>8),(uint8_t)ry1};
    st7735_send_cmd_data(0x2A, ca, 4);
    st7735_send_cmd_data(0x2B, ra, 4);
}

static void render_line(int row, const char *text, uint16_t fg, uint16_t bg)
{
    if (!s_ok) return;

    int y0 = row * CHAR_H;
    st7735_set_window(0, y0, LCD_WIDTH - 1, y0 + CHAR_H - 1);

    int len = text ? (int)strlen(text) : 0;
    for (int i = 0; i < LCD_WIDTH * CHAR_H; i++)
        s_row_buf[i] = bg;

    for (int ci = 0; ci < COLS && ci < len; ci++) {
        unsigned char ch = (unsigned char)text[ci];
        if (ch < 32 || ch > 126) ch = ' ';
        const uint8_t *glyph = font5x8[ch - 32];
        int x0 = ci * CHAR_W;
        for (int col = 0; col < 5; col++) {
            uint8_t bits = glyph[col];
            for (int bit = 0; bit < 8; bit++) {
                if (bits & (1 << bit)) {
                    int px = x0 + col * 2;
                    int py = bit * 2 + 2;
                    s_row_buf[py       * LCD_WIDTH + px]     = fg;
                    s_row_buf[py       * LCD_WIDTH + px + 1] = fg;
                    s_row_buf[(py + 1) * LCD_WIDTH + px]     = fg;
                    s_row_buf[(py + 1) * LCD_WIDTH + px + 1] = fg;
                }
            }
        }
    }

    esp_lcd_panel_io_tx_color(s_io, 0x2C, s_row_buf, LCD_WIDTH * CHAR_H * 2);
}

static const uint8_t st7735_init_cmds[] = {
    0x01, 0,
    0xFF,150,
    0x11, 0,
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    0xFF,100,
    0x00
};

void lcd_init(void)
{
    spi_bus_config_t bus = {
        .mosi_io_num     = LCD_PIN_MOSI,
        .miso_io_num     = -1,
        .sclk_io_num     = LCD_PIN_CLK,
        .quadwp_io_num   = -1,
        .quadhd_io_num   = -1,
        .max_transfer_sz = LCD_WIDTH * CHAR_H * 2 + 64,
    };
    esp_err_t err = spi_bus_initialize(LCD_SPI_HOST, &bus, SPI_DMA_CH_AUTO);
    if (err != ESP_OK && err != ESP_ERR_INVALID_STATE) {
        ESP_LOGW(TAG, "LCD SPI bus init failed: %s", esp_err_to_name(err));
        return;
    }

    esp_lcd_panel_io_spi_config_t io_cfg = {
        .cs_gpio_num     = LCD_PIN_CS,
        .dc_gpio_num     = LCD_PIN_DC,
        .spi_mode        = 0,
        .pclk_hz         = 40 * 1000 * 1000,
        .trans_queue_depth = 10,
        .lcd_cmd_bits    = 8,
        .lcd_param_bits  = 8,
    };
    if (esp_lcd_new_panel_io_spi((esp_lcd_spi_bus_handle_t)LCD_SPI_HOST,
                                  &io_cfg, &s_io) != ESP_OK) {
        ESP_LOGW(TAG, "LCD panel IO init failed");
        return;
    }

    gpio_set_direction(LCD_PIN_RST, GPIO_MODE_OUTPUT);
    gpio_set_level(LCD_PIN_RST, 0);
    vTaskDelay(pdMS_TO_TICKS(10));
    gpio_set_level(LCD_PIN_RST, 1);
    vTaskDelay(pdMS_TO_TICKS(120));

    const uint8_t *p = st7735_init_cmds;
    while (*p) {
        uint8_t cmd = *p++;
        if (cmd == 0xFF) {
            vTaskDelay(pdMS_TO_TICKS(*p++));
            continue;
        }
        uint8_t argc = *p++;
        if (argc > 0) {
            st7735_send_cmd_data(cmd, p, argc);
            p += argc;
        } else {
            st7735_send_cmd(cmd);
        }
    }

    ledc_timer_config_t lt = {
        .speed_mode      = LEDC_LOW_SPEED_MODE,
        .timer_num       = LEDC_TIMER_1,
        .duty_resolution = LEDC_TIMER_8_BIT,
        .freq_hz         = 1000,
        .clk_cfg         = LEDC_AUTO_CLK,
    };
    ledc_timer_config(&lt);
    ledc_channel_config_t lc = {
        .speed_mode = LEDC_LOW_SPEED_MODE,
        .channel    = LEDC_CHANNEL_3,
        .timer_sel  = LEDC_TIMER_1,
        .gpio_num   = LCD_PIN_BL,
        .duty       = 128,
        .hpoint     = 0,
    };
    ledc_channel_config(&lc);

    s_mutex = xSemaphoreCreateMutex();
    s_ok = true;

    uint16_t black = rgb565(0, 0, 0);
    for (int i = 0; i < LCD_WIDTH * CHAR_H; i++) s_row_buf[i] = black;
    for (int y = 0; y < LCD_HEIGHT; y += CHAR_H) {
        int h = (y + CHAR_H > LCD_HEIGHT) ? LCD_HEIGHT - y : CHAR_H;
        st7735_set_window(0, y, LCD_WIDTH - 1, y + h - 1);
        esp_lcd_panel_io_tx_color(s_io, 0x2C, s_row_buf, LCD_WIDTH * h * 2);
    }

    ESP_LOGI(TAG, "ST7735 160x80 LCD ready");
}

void lcd_update(const char *line1, const char *line2,
                const char *line3, const char *line4)
{
    if (!s_ok) return;
    if (xSemaphoreTake(s_mutex, pdMS_TO_TICKS(1000)) != pdTRUE) return;

    uint16_t white = rgb565(255, 255, 255);
    uint16_t green = rgb565(0, 200, 0);
    uint16_t blue  = rgb565(60, 120, 255);
    uint16_t black = rgb565(0, 0, 0);
    uint16_t dim   = rgb565(120, 120, 120);

    render_line(0, line1, white, black);
    render_line(1, line2, green, black);
    render_line(2, line3, dim, black);
    render_line(3, line4, blue, black);

    xSemaphoreGive(s_mutex);
}
