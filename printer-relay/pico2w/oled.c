/*
 * Minimal SSD1306 128x64 I2C status display for the printer relay, mirroring the
 * Pi Zero's display_daemon layout. Self-contained: a 5x7 font, a 1 KB frame
 * buffer, and horizontal-addressing flush. If no panel ACKs (or OLED_ENABLED is
 * 0) every entry point is a no-op so the rest of the firmware is unaffected.
 */
#include "oled.h"
#include "config.h"

#if OLED_ENABLED
#include "pico/stdlib.h"
#include "hardware/i2c.h"
#include <string.h>
#include <stdio.h>

#define OLED_W 128
#define OLED_HGT 64
#define OLED_PAGES (OLED_HGT / 8)

static bool    _present;
static uint8_t _fb[OLED_W * OLED_PAGES];   // 1024 bytes, page-major

// 5x7 font, ASCII 0x20..0x7E, 5 column-bytes each (LSB = top row).
static const uint8_t FONT5x7[][5] = {
  {0x00,0x00,0x00,0x00,0x00}, // ' '
  {0x00,0x00,0x5f,0x00,0x00}, // '!'
  {0x00,0x07,0x00,0x07,0x00}, // '"'
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  {0x08,0x04,0x08,0x10,0x08}, // '~'
};

static void cmd(uint8_t c) {
  uint8_t buf[2] = { 0x00, c };   // 0x00 = Co=0, D/C#=0 (command)
  i2c_write_blocking(OLED_I2C, OLED_I2C_ADDR, buf, 2, false);
}

static void draw_char(int x, int page, char ch) {
  if (ch < 0x20 || ch > 0x7e) ch = '?';
  const uint8_t* g = FONT5x7[ch - 0x20];
  for (int col = 0; col < 5; col++) {
    int px = x + col;
    if (px >= 0 && px < OLED_W && page >= 0 && page < OLED_PAGES)
      _fb[page * OLED_W + px] = g[col];
  }
}

static void draw_text(int x, int page, const char* s) {
  while (*s && x < OLED_W) { draw_char(x, page, *s++); x += 6; }
}

static void invert_page(int page) {
  if (page < 0 || page >= OLED_PAGES) return;
  for (int x = 0; x < OLED_W; x++) _fb[page * OLED_W + x] ^= 0xff;
}

static void flush(void) {
  if (!_present) return;
  cmd(0x21); cmd(0); cmd(OLED_W - 1);          // column range 0..127
  cmd(0x22); cmd(0); cmd(OLED_PAGES - 1);      // page range 0..7
  // Send framebuffer in chunks with a leading 0x40 (data) control byte.
  uint8_t chunk[1 + 16];
  for (int i = 0; i < (int) sizeof(_fb); i += 16) {
    chunk[0] = 0x40;
    memcpy(&chunk[1], &_fb[i], 16);
    i2c_write_blocking(OLED_I2C, OLED_I2C_ADDR, chunk, sizeof(chunk), false);
  }
}

bool oled_init(void) {
  i2c_init(OLED_I2C, OLED_I2C_BAUD);
  gpio_set_function(OLED_SDA_PIN, GPIO_FUNC_I2C);
  gpio_set_function(OLED_SCL_PIN, GPIO_FUNC_I2C);
  gpio_pull_up(OLED_SDA_PIN);
  gpio_pull_up(OLED_SCL_PIN);

  // Probe: a 0-length write returns the number of bytes (>=0) on ACK, <0 on none.
  uint8_t z = 0;
  int r = i2c_write_timeout_us(OLED_I2C, OLED_I2C_ADDR, &z, 1, false, 2000);
  if (r < 0) { _present = false; return false; }
  _present = true;

  static const uint8_t init[] = {
    0xAE, 0x20,0x00, 0xB0, 0xC8, 0x00,0x10, 0x40, 0x81,0x7F, 0xA1, 0xA6,
    0xA8,0x3F, 0xA4, 0xD3,0x00, 0xD5,0x80, 0xD9,0xF1, 0xDA,0x12, 0xDB,0x40,
    0x8D,0x14, 0xAF
  };
  for (size_t i = 0; i < sizeof(init); i++) cmd(init[i]);
  memset(_fb, 0, sizeof(_fb));
  flush();
  return true;
}

bool oled_present(void) { return _present; }

void oled_status(bool wifi_up, const char* ip, bool server_up,
                 uint32_t jobs, const char* last_hms, const char* clock_hms) {
  if (!_present) return;
  memset(_fb, 0, sizeof(_fb));
  char line[24];

  draw_text(2, 0, "Printer Relay");
  invert_page(0);                                   // inverted header bar

  snprintf(line, sizeof(line), "WiFi:   %s", wifi_up ? ip : "down");
  draw_text(0, 2, line);
  snprintf(line, sizeof(line), "Server: %s", server_up ? "online" : "offline");
  draw_text(0, 3, line);
  snprintf(line, sizeof(line), "Jobs:   %lu", (unsigned long) jobs);
  draw_text(0, 4, line);
  snprintf(line, sizeof(line), "Last:   %s", last_hms);
  draw_text(0, 5, line);
  draw_text(0, 7, (char*) clock_hms);
  flush();
}

void oled_banner(const char* line) {
  if (!_present) return;
  memset(_fb, 0, sizeof(_fb));
  draw_text(4, 3, line);
  for (int p = 0; p < OLED_PAGES; p++) invert_page(p);
  flush();
}

#else  // OLED_ENABLED == 0 — compile out entirely

bool oled_init(void) { return false; }
bool oled_present(void) { return false; }
void oled_status(bool w, const char* i, bool s, uint32_t j,
                 const char* l, const char* c) { (void)w;(void)i;(void)s;(void)j;(void)l;(void)c; }
void oled_banner(const char* line) { (void) line; }

#endif // OLED_ENABLED
